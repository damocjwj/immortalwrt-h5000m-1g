// SPDX-License-Identifier: (GPL-2.0 OR MIT)

#include "mt7987a-hiveton-h5000m.dts"

/ {
	model = "Hiveton H5000M (1G/8G)";
	compatible = "hiveton,h5000m-1g",
		     "hiveton,h5000m",
		     "mediatek,mt7987a",
		     "mediatek,mt7987";

	memory {
		device_type = "memory";
		reg = <0x0 0x40000000 0x0 0x40000000>;
	};
};
